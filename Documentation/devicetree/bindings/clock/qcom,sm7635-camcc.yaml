## Documentation/devicetree/bindings/clock/qcom,sm7635-camcc.yaml
```yaml
# SPDX-License-Identifier: (GPL-2.0-only OR BSD-2-Clause)
%YAML 1.2
---
$id: http://devicetree.org/schemas/clock/qcom,sm7635-camcc.yaml#
$schema: http://devicetree.org/meta-schemas/core.yaml#

title: Qualcomm Camera Clock & Reset Controller on SM7635

maintainers:
  - Luca Weiss <luca.weiss@fairphone.com>

description: |
  Qualcomm camera clock control module provides the clocks, resets and power
  domains on SM7635.

  See also: include/dt-bindings/clock/qcom,sm7635-camcc.h

properties:
  compatible:
    const: qcom,sm7635-camcc

  clocks:
    items:
      - description: Board XO source
      - description: Sleep clock source
      - description: Camera AHB clock from GCC

required:
  - compatible
  - clocks

allOf:
  - $ref: qcom,gcc.yaml#

unevaluatedProperties: false

examples:
  - |
    #include <dt-bindings/clock/qcom,sm7635-gcc.h>
    clock-controller@adb0000 {
        compatible = "qcom,sm7635-camcc";
        reg = <0x0adb0000 0x40000>;
        clocks = <&bi_tcxo_div2>,
                 <&sleep_clk>,
                 <&gcc GCC_CAMERA_AHB_CLK>;
        #clock-cells = <1>;
        #reset-cells = <1>;
        #power-domain-cells = <1>;
    };

...
```

## Documentation/devicetree/bindings/clock/qcom,sm7635-dispcc.yaml
```yaml
# SPDX-License-Identifier: (GPL-2.0-only OR BSD-2-Clause)
%YAML 1.2
---
$id: http://devicetree.org/schemas/clock/qcom,sm7635-dispcc.yaml#
$schema: http://devicetree.org/meta-schemas/core.yaml#

title: Qualcomm Display Clock & Reset Controller on SM7635

maintainers:
  - Luca Weiss <luca.weiss@fairphone.com>

description: |
  Qualcomm display clock control module provides the clocks, resets and power
  domains on SM7635.

  See also: include/dt-bindings/clock/qcom,sm7635-dispcc.h

properties:
  compatible:
    const: qcom,sm7635-dispcc

  clocks:
    items:
      - description: Board XO source
      - description: Sleep clock source
      - description: Display's AHB clock
      - description: GPLL0 source from GCC
      - description: Byte clock from DSI PHY0
      - description: Pixel clock from DSI PHY0
      - description: Link clock from DP PHY0
      - description: VCO DIV clock from DP PHY0

required:
  - compatible
  - clocks
  - '#power-domain-cells'

allOf:
  - $ref: qcom,gcc.yaml#

unevaluatedProperties: false

examples:
  - |
    #include <dt-bindings/clock/qcom,sm7635-gcc.h>
    #include <dt-bindings/phy/phy-qcom-qmp.h>
    clock-controller@af00000 {
        compatible = "qcom,sm7635-dispcc";
        reg = <0x0af00000 0x20000>;
        clocks = <&bi_tcxo_div2>,
                 <&sleep_clk>,
                 <&gcc GCC_DISP_AHB_CLK>,
                 <&gcc GCC_DISP_GPLL0_DIV_CLK_SRC>,
                 <&mdss_dsi0_phy 0>,
                 <&mdss_dsi0_phy 1>,
                 <&usb_dp_qmpphy QMP_USB43DP_DP_LINK_CLK>,
                 <&usb_dp_qmpphy QMP_USB43DP_DP_VCO_DIV_CLK>;
        #clock-cells = <1>;
        #reset-cells = <1>;
        #power-domain-cells = <1>;
    };

...
```

## Documentation/devicetree/bindings/clock/qcom,sm7635-videocc.yaml
```yaml
# SPDX-License-Identifier: (GPL-2.0-only OR BSD-2-Clause)
%YAML 1.2
---
$id: http://devicetree.org/schemas/clock/qcom,sm7635-videocc.yaml#
$schema: http://devicetree.org/meta-schemas/core.yaml#

title: Qualcomm Video Clock & Reset Controller on SM7635

maintainers:
  - Luca Weiss <luca.weiss@fairphone.com>

description: |
  Qualcomm video clock control module provides the clocks, resets and power
  domains on SM7635.

  See also: include/dt-bindings/clock/qcom,sm7635-videocc.h

properties:
  compatible:
    const: qcom,sm7635-videocc

  clocks:
    items:
      - description: Board XO source
      - description: Board active XO source
      - description: Sleep clock source
      - description: Video AHB clock from GCC

required:
  - compatible
  - clocks

allOf:
  - $ref: qcom,gcc.yaml#

unevaluatedProperties: false

examples:
  - |
    #include <dt-bindings/clock/qcom,sm7635-gcc.h>
    clock-controller@aaf0000 {
        compatible = "qcom,sm7635-videocc";
        reg = <0x0aaf0000 0x10000>;
        clocks = <&bi_tcxo_div2>,
                 <&bi_tcxo_ao_div2>,
                 <&sleep_clk>,
                 <&gcc GCC_VIDEO_AHB_CLK>;
        #clock-cells = <1>;
        #reset-cells = <1>;
        #power-domain-cells = <1>;
    };

...
```

## Documentation/devicetree/bindings/display/panel/visionox,g2678fp111.yaml
```yaml
# SPDX-License-Identifier: (GPL-2.0-only OR BSD-2-Clause)
%YAML 1.2
---
$id: http://devicetree.org/schemas/display/panel/visionox,g2678fp111.yaml#
$schema: http://devicetree.org/meta-schemas/core.yaml#

title: Visionox G2678FP111 6.77" 1080x2392 AMOLED Panel

maintainers:
  - Alexander Koskovich <akoskovich@pm.me>

description:
  This is a 6.77" AMOLED video mode display panel on a MIPI-DSI 4-lane
  interface.

  The panel also requires ELVDD/ELVSS/ELAVDD rails but these are
  internally managed by the panel via EL_ON1 (ELAVDD) and EL_ON2
  (ELVDD/ELVSS) control signals, they are not managed by the platform.

  The driver IC for this panel assembly is an RM69220.

allOf:
  - $ref: panel-common.yaml#

properties:
  compatible:
    const: visionox,g2678fp111

  reg:
    maxItems: 1

  dvdd-supply:
    description: Digital voltage rail

  vci-supply:
    description: Analog voltage rail

  vddio-supply:
    description: I/O voltage rail

required:
  - compatible
  - reg
  - reset-gpios
  - dvdd-supply
  - vci-supply
  - vddio-supply
  - port

unevaluatedProperties: false

examples:
  - |
    #include <dt-bindings/gpio/gpio.h>

    dsi {
        #address-cells = <1>;
        #size-cells = <0>;

        panel@0 {
            compatible = "visionox,g2678fp111";
            reg = <0>;

            reset-gpios = <&tlmm 12 GPIO_ACTIVE_LOW>;
            dvdd-supply = <&vreg_oled_dvdd_1p8>;
            vci-supply = <&vreg_l19b>;
            vddio-supply = <&vreg_l9b>;

            port {
                panel_in_0: endpoint {
                    remote-endpoint = <&dsi0_out>;
                };
            };
        };
    };

...
```

## Documentation/devicetree/bindings/input/touchscreen/focaltech,ft3683g.yaml
```yaml
# SPDX-License-Identifier: (GPL-2.0-only OR BSD-2-Clause)
%YAML 1.2
---
$id: http://devicetree.org/schemas/input/touchscreen/focaltech,ft3683g.yaml#
$schema: http://devicetree.org/meta-schemas/core.yaml#

title: FocalTech FT3683G touchscreen controller

maintainers:
  - Alexander Koskovich <akoskovich@pm.me>

allOf:
  - $ref: touchscreen.yaml#

properties:
  compatible:
    const: focaltech,ft3683g

  reg:
    maxItems: 1

  interrupts:
    maxItems: 1

  reset-gpios:
    maxItems: 1

  vci-supply:
    description: Analog power supply

  vddio-supply:
    description: Digital I/O power supply

  spi-max-frequency: true

required:
  - compatible
  - reg
  - interrupts
  - reset-gpios
  - vci-supply
  - vddio-supply

unevaluatedProperties: false

examples:
  - |
    #include <dt-bindings/gpio/gpio.h>
    #include <dt-bindings/interrupt-controller/irq.h>

    spi {
      #address-cells = <1>;
      #size-cells = <0>;

      touchscreen@0 {
        compatible = "focaltech,ft3683g";
        reg = <0>;

        vci-supply = <&vreg_l22b>;
        vddio-supply = <&vreg_l11b>;

        reset-gpios = <&tlmm 20 GPIO_ACTIVE_LOW>;

        interrupt-parent = <&tlmm>;
        interrupts = <19 IRQ_TYPE_EDGE_FALLING>;
        spi-max-frequency = <12000000>;

        touchscreen-size-x = <1080>;
        touchscreen-size-y = <2392>;
      };
    };

...
```

## Documentation/devicetree/bindings/media/i2c/ovti,ov13b10.yaml
```yaml
# SPDX-License-Identifier: (GPL-2.0 OR BSD-2-Clause)
%YAML 1.2
---
$id: http://devicetree.org/schemas/media/i2c/ovti,ov13b10.yaml#
$schema: http://devicetree.org/meta-schemas/core.yaml#

title: OmniVision OV13B10 Image Sensor

maintainers:
  - Luca Weiss <luca.weiss@fairphone.com>

allOf:
  - $ref: /schemas/media/video-interface-devices.yaml#

properties:
  compatible:
    const: ovti,ov13b10

  reg:
    maxItems: 1

  clocks:
    items:
      - description: EXTCLK Clock

  avdd-supply:
    description: Analog Power Supply

  dovdd-supply:
    description: I/O Power Supply

  dvdd-supply:
    description: Core Power Supply

  reset-gpios:
    maxItems: 1
    description: Reset Pin GPIO Control (active low)

  port:
    additionalProperties: false
    $ref: /schemas/graph.yaml#/$defs/port-base

    properties:
      endpoint:
        $ref: /schemas/media/video-interfaces.yaml#
        unevaluatedProperties: false

        properties:
          link-frequencies: true

          data-lanes:
            minItems: 1
            maxItems: 4

        required:
          - data-lanes
          - link-frequencies

required:
  - compatible
  - reg
  - clocks
  - avdd-supply
  - dovdd-supply
  - dvdd-supply
  - port

unevaluatedProperties: false

examples:
  - |
    #include <dt-bindings/clock/qcom,sm8650-camcc.h>
    #include <dt-bindings/gpio/gpio.h>
    #include <dt-bindings/media/video-interfaces.h>

    i2c {
        #address-cells = <1>;
        #size-cells = <0>;

        camera@36 {
            compatible = "ovti,ov13b10";
            reg = <0x36>;

            avdd-supply = <&vreg_cam_avdd>;
            dovdd-supply = <&vreg_cam_dovdd>;
            dvdd-supply = <&vreg_cam_dvdd>;

            clocks = <&camcc CAM_CC_MCLK1_CLK>;
            assigned-clocks = <&camcc CAM_CC_MCLK1_CLK>;
            assigned-clock-rates = <24000000>;

            reset-gpios = <&tlmm 41 GPIO_ACTIVE_LOW>;
            pinctrl-0 = <&cam_mclk1_default>;
            pinctrl-names = "default";

            orientation = <1>;
            rotation = <270>;

            port {
                endpoint {
                    data-lanes = <1 2 3 4>;
                    bus-type = <MEDIA_BUS_TYPE_CSI2_DPHY>;
                    link-frequencies = /bits/ 64 <560000000>;
                    remote-endpoint = <&csiphy1_ep>;
                };
            };
        };
    };

...
```

## arch/arm64/configs/x04g_defconfig
```kconfig
CONFIG_LOCALVERSION="-mt8167"
CONFIG_SYSVIPC=y
CONFIG_NO_HZ=y
CONFIG_HIGH_RES_TIMERS=y
CONFIG_IKCONFIG=y
CONFIG_IKCONFIG_PROC=y
CONFIG_CGROUPS=y
CONFIG_BLK_CGROUP=y
CONFIG_BLK_DEV_INITRD=y
CONFIG_PERF_EVENTS=y
CONFIG_ARCH_MEDIATEK=y
CONFIG_NR_CPUS=4
CONFIG_HZ_100=y
# CONFIG_ARM64_SVE is not set
# CONFIG_EFI is not set
CONFIG_CPU_IDLE=y
CONFIG_CPU_FREQ=y
CONFIG_CPUFREQ_DT=y
CONFIG_ARM_MEDIATEK_CPUFREQ=y
CONFIG_ARM_MEDIATEK_CPUFREQ_HW=y
CONFIG_COMPAT_32BIT_TIME=y
CONFIG_MODULES=y
CONFIG_MODULE_UNLOAD=y
CONFIG_MODULE_COMPRESS=y
CONFIG_MODULE_COMPRESS_ZSTD=y
CONFIG_PARTITION_ADVANCED=y
# CONFIG_IOSCHED_BFQ is not set
CONFIG_ZSMALLOC_STAT=y
CONFIG_LRU_GEN=y
CONFIG_LRU_GEN_ENABLED=y
CONFIG_NET=y
CONFIG_PACKET=y
CONFIG_UNIX=y
CONFIG_INET=y
CONFIG_IP_MULTICAST=y
CONFIG_IP_PNP=y
CONFIG_IP_PNP_DHCP=y
CONFIG_IP_PNP_BOOTP=y
CONFIG_IP_PNP_RARP=y
CONFIG_NETFILTER=y
CONFIG_NF_CONNTRACK=y
CONFIG_NF_NAT=y
CONFIG_NF_TABLES=y
CONFIG_NF_TABLES_INET=y
CONFIG_NFT_CT=m
CONFIG_NFT_LOG=m
CONFIG_NFT_REJECT=m
CONFIG_RFKILL=y
CONFIG_PCI=y
CONFIG_PCIEPORTBUS=y
CONFIG_PCI_HOST_GENERIC=y
CONFIG_DEVTMPFS=y
CONFIG_DEVTMPFS_MOUNT=y
CONFIG_MTD=y
CONFIG_MTD_BLOCK=y
CONFIG_MTD_RAW_NAND=y
CONFIG_ZRAM=m
CONFIG_ZRAM_MEMORY_TRACKING=y
CONFIG_BLK_DEV_LOOP=y
CONFIG_BLK_DEV_NBD=m
CONFIG_SRAM=y
CONFIG_BLK_DEV_SD=y
CONFIG_ATA=y
CONFIG_SATA_AHCI=y
CONFIG_SATA_MOBILE_LPM_POLICY=0
CONFIG_SATA_AHCI_PLATFORM=y
CONFIG_SATA_MV=y
CONFIG_MD=y
CONFIG_BLK_DEV_DM=y
CONFIG_DM_CRYPT=y
CONFIG_NETDEVICES=y
CONFIG_INPUT_EVDEV=y
CONFIG_KEYBOARD_MT6779=y
CONFIG_KEYBOARD_MTK_PMIC=y
CONFIG_INPUT_TOUCHSCREEN=y
CONFIG_INPUT_MISC=y
CONFIG_SERIO_RAW=y
CONFIG_SERIAL_8250=y
CONFIG_SERIAL_8250_CONSOLE=y
CONFIG_SERIAL_8250_EXTENDED=y
CONFIG_SERIAL_8250_SHARE_IRQ=y
CONFIG_SERIAL_8250_MT6577=y
CONFIG_SERIAL_OF_PLATFORM=y
CONFIG_SERIAL_DEV_BUS=y
CONFIG_HW_RANDOM=y
CONFIG_I2C_CHARDEV=y
CONFIG_I2C_MUX=y
CONFIG_I2C_GPIO=y
CONFIG_I2C_MT65XX=y
CONFIG_I2C_SLAVE=y
CONFIG_SPI=y
CONFIG_SPI_MT65XX=y
CONFIG_SPI_MTK_NOR=y
CONFIG_SPMI=y
CONFIG_SPMI_MTK_PMIF=y
CONFIG_THERMAL=y
CONFIG_MTK_THERMAL=y
CONFIG_MTK_SOC_THERMAL=y
CONFIG_MTK_LVTS_THERMAL=y
CONFIG_WATCHDOG=y
CONFIG_MFD_MT6397=y
CONFIG_MFD_SYSCON=y
CONFIG_REGULATOR_FIXED_VOLTAGE=y
CONFIG_REGULATOR_GPIO=y
CONFIG_REGULATOR_MT6392=y
CONFIG_REGULATOR_PWM=y
CONFIG_REGULATOR_VCTRL=y
CONFIG_DRM=y
CONFIG_DRM_SIMPLEDRM=y
CONFIG_DRM_PANEL_SIMPLE=y
CONFIG_DRM_MEDIATEK=y
CONFIG_FB=y
CONFIG_FB_MODE_HELPERS=y
CONFIG_BACKLIGHT_CLASS_DEVICE=y
CONFIG_DUMMY_CONSOLE_ROWS=30
CONFIG_FRAMEBUFFER_CONSOLE_LEGACY_ACCELERATION=y
CONFIG_LOGO=y
CONFIG_I2C_HID=m
CONFIG_USB=y
CONFIG_USB_ANNOUNCE_NEW_DEVICES=y
CONFIG_USB_MUSB_HDRC=y
CONFIG_USB_MUSB_MEDIATEK=y
CONFIG_USB_INVENTRA_DMA=y
CONFIG_NOP_USB_XCEIV=y
CONFIG_USB_GADGET=y
CONFIG_U_SERIAL_CONSOLE=y
CONFIG_USB_CONFIGFS=y
CONFIG_USB_CONFIGFS_SERIAL=y
CONFIG_USB_CONFIGFS_ACM=y
CONFIG_USB_CONFIGFS_OBEX=y
CONFIG_USB_CONFIGFS_NCM=y
CONFIG_USB_CONFIGFS_ECM=y
CONFIG_USB_CONFIGFS_ECM_SUBSET=y
CONFIG_USB_CONFIGFS_RNDIS=y
CONFIG_USB_CONFIGFS_EEM=y
CONFIG_USB_CONFIGFS_MASS_STORAGE=y
CONFIG_USB_CONFIGFS_F_FS=y
CONFIG_USB_CONFIGFS_F_HID=y
CONFIG_MMC=y
CONFIG_MMC_MTK=y
CONFIG_RTC_CLASS=y
CONFIG_RTC_DRV_MT6397=y
CONFIG_RTC_DRV_MT7622=y
CONFIG_DMADEVICES=y
CONFIG_MTK_HSDMA=y
CONFIG_MTK_CQDMA=y
CONFIG_MTK_UART_APDMA=y
# CONFIG_COMMON_CLK_MT8365 is not set
CONFIG_COMMON_CLK_MT8516_AUDSYS=y
CONFIG_MTK_ADSP_MBOX=y
CONFIG_ARM_SMMU=y
CONFIG_ARM_SMMU_V3=y
CONFIG_MTK_IOMMU=y
CONFIG_REMOTEPROC=y
CONFIG_MTK_SCP=y
CONFIG_MTK_CMDQ=y
CONFIG_MTK_DEVAPC=y
CONFIG_MTK_PMIC_WRAP=y
CONFIG_MTK_SVS=y
# CONFIG_MTK_SOCINFO is not set
CONFIG_EXTCON_GPIO=y
CONFIG_EXTCON_USB_GPIO=y
CONFIG_IIO=y
CONFIG_MEDIATEK_MT6577_AUXADC=y
CONFIG_PWM=y
CONFIG_PWM_MEDIATEK=y
CONFIG_PWM_MTK_DISP=y
CONFIG_PHY_MTK_TPHY=y
CONFIG_PHY_MTK_MIPI_DSI=y
CONFIG_NVMEM_MTK_EFUSE=y
CONFIG_NVMEM_RMEM=y
CONFIG_NVMEM_SPMI_SDAM=y
CONFIG_INTERCONNECT=y
CONFIG_INTERCONNECT_MTK=y
CONFIG_EXT3_FS=y
CONFIG_EXT4_FS_POSIX_ACL=y
CONFIG_EXT4_FS_SECURITY=y
CONFIG_FS_ENCRYPTION=y
CONFIG_FS_VERITY=y
CONFIG_FS_VERITY_BUILTIN_SIGNATURES=y
CONFIG_TMPFS=y
CONFIG_TMPFS_POSIX_ACL=y
CONFIG_TMPFS_INODE64=y
CONFIG_TMPFS_QUOTA=y
CONFIG_CRYPTO_CRC32C=y
CONFIG_CRYPTO_LZO=m
CONFIG_CRYPTO_LZ4=m
CONFIG_CRYPTO_ZSTD=m
CONFIG_PRINTK_TIME=y
CONFIG_DEBUG_KERNEL=y
CONFIG_DEBUG_INFO_DWARF5=y
CONFIG_FRAME_WARN=1024
CONFIG_MAGIC_SYSRQ=y
# CONFIG_FTRACE is not set
# CONFIG_STRICT_DEVMEM is not set
```
