## Documentation/devicetree/bindings/clock/qcom,sm6350-camcc.yaml
```yaml
# SPDX-License-Identifier: (GPL-2.0-only OR BSD-2-Clause)
%YAML 1.2
---
$id: http://devicetree.org/schemas/clock/qcom,sm6350-camcc.yaml#
$schema: http://devicetree.org/meta-schemas/core.yaml#

title: Qualcomm Camera Clock & Reset Controller on SM6350

maintainers:
  - Konrad Dybcio <konrad.dybcio@linaro.org>

description: |
  Qualcomm camera clock control module provides the clocks, resets and  power
  domains on SM6350.

  See also:: include/dt-bindings/clock/qcom,sm6350-camcc.h

properties:
  compatible:
    const: qcom,sm6350-camcc

  clocks:
    items:
      - description: Board XO source

  power-domains:
    maxItems: 1
    description:
      A phandle and PM domain specifier for the CX power domain.

  required-opps:
    description:
      A phandle to an OPP node describing required CX performance point.

  reg:
    maxItems: 1

required:
  - compatible
  - clocks
  - power-domains
  - required-opps

allOf:
  - $ref: qcom,gcc.yaml#

unevaluatedProperties: false

examples:
  - |
    #include <dt-bindings/clock/qcom,rpmh.h>
    clock-controller@ad00000 {
      compatible = "qcom,sm6350-camcc";
      reg = <0x0ad00000 0x16000>;
      clocks = <&rpmhcc RPMH_CXO_CLK>;
      #clock-cells = <1>;
      #reset-cells = <1>;
      #power-domain-cells = <1>;
    };
...
```

## Documentation/devicetree/bindings/display/panel/bananapi,s070wv20-ct16.txt
```
Banana Pi 7" (S070WV20-CT16) TFT LCD Panel

S070WV20-CT16 is 7" 800x480 panel connected through a 24-bit RGB interface.

Depending on the variant, the PCB attached to the panel module either
supports DSI, or DSI + 24-bit RGB. DSI is converted to 24-bit RGB via
an onboard ICN6211 MIPI DSI - RGB bridge chip, then fed to the panel
itself

Required properties:
- compatible:
  for 24-bit RGB interface, use "bananapi,s070wv20-ct16"
  for ICN6211 MIPI-DSI to RGB bridge, use "bananapi,s070wv20-ct16-icn6211"

Required properties for RGB:
- power-supply: see ./panel-common.txt

Required properties for MIPI-DSI to RGB:
- reg: for DSI virtual channel used by that screen
- reset-gpios: a GPIO phandle for the reset pin

Optional properties:
- enable-gpios: see ./simple-panel.txt(not available in MIPI-DSI to RGB bridge)
- backlight: see ./simple-panel.txt

This binding is compatible with the simple-panel binding, which is specified
in ./simple-panel.txt.

Example:
panel@0 {
	compatible = "bananapi,s070wv20-ct16-icn6211";
	reg = <0>;
	reset-gpios = <&pio 3 6 GPIO_ACTIVE_HIGH>; /* PD6 */
	backlight = <&backlight_dsi>;
};
```

## Documentation/devicetree/bindings/input/gpio-vibrator.txt
```
* GPIO vibrator device tree bindings

Registers a GPIO device as vibrator, where the vibration motor just has the
capability to turn on or off. If the device is connected to a pwm, you should
use the pwm-vibrator driver instead.

Required properties:
- compatible: should contain "gpio-vibrator"
- enable-gpios: Should contain a GPIO handle

Optional properties:
- vcc-supply: Phandle for the regulator supplying power

Example from Fairphone 2:

vibrator {
	compatible = "gpio-vibrator";
	enable-gpios = <&msmgpio 86 GPIO_ACTIVE_HIGH>;
	vcc-supply = <&pm8941_l18>;
};
```

## Documentation/devicetree/bindings/leds/leds-qcom-lpg.yaml
```yaml
# SPDX-License-Identifier: (GPL-2.0-only OR BSD-2-Clause)
%YAML 1.2
---
$id: http://devicetree.org/schemas/leds/leds-qcom-lpg.yaml#
$schema: http://devicetree.org/meta-schemas/core.yaml#

title: Qualcomm Light Pulse Generator

maintainers:
  - Bjorn Andersson <bjorn.andersson@linaro.org>

description: >
  The Qualcomm Light Pulse Generator consists of three different hardware blocks;
  a ramp generator with lookup table, the light pulse generator and a three
  channel current sink. These blocks are found in a wide range of Qualcomm PMICs.

properties:
  compatible:
    enum:
      - qcom,pm660l-lpg
      - qcom,pm8150b-lpg
      - qcom,pm8150l-lpg
      - qcom,pm8350c-pwm
      - qcom,pm8916-pwm
      - qcom,pm8941-lpg
      - qcom,pm8994-lpg
      - qcom,pmc8180c-lpg
      - qcom,pmi632-lpg
      - qcom,pmi8994-lpg
      - qcom,pmi8998-lpg

  "#pwm-cells":
    const: 2

  "#address-cells":
    const: 1

  "#size-cells":
    const: 0

  qcom,power-source:
    $ref: /schemas/types.yaml#/definitions/uint32
    description:
      power-source used to drive the output, as defined in the datasheet.
      Should be specified if the TRILED block is present
    enum: [0, 1, 3]

  qcom,dtest:
    $ref: /schemas/types.yaml#/definitions/uint32-matrix
    description: >
      A list of integer pairs, where each pair represent the dtest line the
      particular channel should be connected to and the flags denoting how the
      value should be outputed, as defined in the datasheet. The number of
      pairs should be the same as the number of channels.
    items:
      items:
        - description: dtest line to attach
        - description: flags for the attachment

  nvmem:
    description: >
      Phandle(s) of the nvmem device(s) to access the LUT stored in the SDAM module(s).
      This property is required only when LUT mode is supported and the LUT pattern is
      stored in SDAM modules instead of a LUT module.
    minItems: 1
    maxItems: 2

  nvmem-names:
    description: >
      The nvmem device name(s) for the SDAM module(s) where the LUT pattern data is stored.
      This property is required only when LUT mode is supported with SDAM module instead of
      LUT module.
    minItems: 1
    items:
      - const: lpg_chan_sdam
      - const: lut_sdam

  qcom,pbs-client:
    $ref: /schemas/types.yaml#/definitions/phandle
    description: >
      Phandle of the PBS client used for sending the PBS trigger. This property is
      required when LUT mode is supported and the LUT pattern is stored in a single
      SDAM module instead of a LUT module.

  multi-led:
    type: object
    $ref: leds-class-multicolor.yaml#
    unevaluatedProperties: false

    properties:
      "#address-cells":
        const: 1

      "#size-cells":
        const: 0

    patternProperties:
      "^led@[0-9a-f]$":
        type: object
        $ref: common.yaml#
        unevaluatedProperties: false

        properties:
          reg:
            maxItems: 1

        required:
          - reg

patternProperties:
  "^led@[0-9a-f]$":
    type: object
    $ref: common.yaml#
    unevaluatedProperties: false

    properties:
      reg:
        maxItems: 1

    required:
      - reg

required:
  - compatible

additionalProperties: false

examples:
  - |
    #include <dt-bindings/leds/common.h>

    led-controller {
      compatible = "qcom,pmi8994-lpg";

      #address-cells = <1>;
      #size-cells = <0>;

      qcom,power-source = <1>;

      qcom,dtest = <0 0>,
                   <0 0>,
                   <0 0>,
                   <4 1>;

      led@1 {
        reg = <1>;
        color = <LED_COLOR_ID_GREEN>;
        function = LED_FUNCTION_INDICATOR;
        function-enumerator = <1>;
      };

      led@2 {
        reg = <2>;
        color = <LED_COLOR_ID_GREEN>;
        function = LED_FUNCTION_INDICATOR;
        function-enumerator = <0>;
        default-state = "on";
      };

      led@3 {
        reg = <3>;
        color = <LED_COLOR_ID_GREEN>;
        function = LED_FUNCTION_INDICATOR;
        function-enumerator = <2>;
      };

      led@4 {
        reg = <4>;
        color = <LED_COLOR_ID_GREEN>;
        function = LED_FUNCTION_INDICATOR;
        function-enumerator = <3>;
      };
    };
  - |
    #include <dt-bindings/leds/common.h>

    led-controller {
      compatible = "qcom,pmi8994-lpg";

      #address-cells = <1>;
      #size-cells = <0>;

      qcom,power-source = <1>;

      multi-led {
        color = <LED_COLOR_ID_RGB>;
        function = LED_FUNCTION_STATUS;

        #address-cells = <1>;
        #size-cells = <0>;

        led@1 {
          reg = <1>;
          color = <LED_COLOR_ID_RED>;
        };

        led@2 {
          reg = <2>;
          color = <LED_COLOR_ID_GREEN>;
        };

        led@3 {
          reg = <3>;
          color = <LED_COLOR_ID_BLUE>;
        };
      };
    };
  - |
    pwm-controller {
      compatible = "qcom,pm8916-pwm";
      #pwm-cells = <2>;
    };
  - |
    #include <dt-bindings/leds/common.h>

    led-controller {
      compatible = "qcom,pm8350c-pwm";
      #address-cells = <1>;
      #size-cells = <0>;
      #pwm-cells = <2>;
      nvmem-names = "lpg_chan_sdam" , "lut_sdam";
      nvmem = <&pmk8550_sdam_21 &pmk8550_sdam_22>;

      led@1 {
        reg = <1>;
        color = <LED_COLOR_ID_RED>;
        label = "red";
      };

      led@2 {
        reg = <2>;
        color = <LED_COLOR_ID_GREEN>;
        label = "green";
      };

      led@3 {
        reg = <3>;
        color = <LED_COLOR_ID_BLUE>;
        label = "blue";
      };
    };
  - |
    #include <dt-bindings/leds/common.h>

    led-controller {
      compatible = "qcom,pmi632-lpg";
      #address-cells = <1>;
      #size-cells = <0>;
      #pwm-cells = <2>;
      nvmem-names = "lpg_chan_sdam";
      nvmem = <&pmi632_sdam7>;
      qcom,pbs-client = <&pmi632_pbs_client3>;

      led@1 {
        reg = <1>;
        color = <LED_COLOR_ID_RED>;
        label = "red";
      };

      led@2 {
        reg = <2>;
        color = <LED_COLOR_ID_GREEN>;
        label = "green";
      };

      led@3 {
        reg = <3>;
        color = <LED_COLOR_ID_BLUE>;
        label = "blue";
      };
    };

...
```

## Documentation/devicetree/bindings/leds/leds-sm5708-fled.yaml
```yaml
# SPDX-License-Identifier: (GPL-2.0-only OR BSD-2-Clause)
%YAML 1.2
---
$id: http://devicetree.org/schemas/leds/leds-sm5708-fled.yaml#
$schema: http://devicetree.org/meta-schemas/core.yaml#

title: Sillicon Mitus SM5708 Double 1.5A/800mA LED Driver.

maintainers:
  - Vladimir Lypak <vladimir.lypak@gmail.com>

description: |
  This module is part of the SM5708 MFD device. For more details
  see Documentation/devicetree/bindings/mfd/sm5708.yaml.
  The SM5708 is a two channel current-regulated flash LED driver
  which can regulate two current levels for Flash and Torch modes.

properties:
  compatible:
    const: siliconmitus,sm5708-fled

  "#address-cells":
    const: 1

  "#size-cells":
    const: 0

  flash-boost-supply:
    description: Regulator providing additional power in flash mode.

patternProperties:
  "^led@[01]$":
    type: object
    $ref: common.yaml#
    properties:
      reg:
        description: Output channel that is connected to the LED.
        enum:
          - 0 # Output channel 1 (up to 1.5A)
          - 1 # Output channel 2 (up to 800mA)

required:
  - compatible
  - "#address-cells"
  - "#size-cells"

additionalProperties: false

examples:
  - |
    #include <dt-bindings/leds/common.h>

    led-controller {
        compatible = "siliconmitus,sm5708-fled";
        flash-boost-supply = <&sm5708_fled_boost>;

        #address-cells = <1>;
        #size-cells = <0>;

        sm5708_flash0: led@0 {
            reg = <0>;
            function = LED_FUNCTION_FLASH;
            color = <LED_COLOR_ID_WHITE>;
            led-max-microamps = <100000>;
            flash-max-microamps = <1000000>;
            flash-max-timeout-us = <400000>;
        };

        sm5708_flash1: led@1 {
            reg = <1>;
            function = LED_FUNCTION_FLASH;
            color = <LED_COLOR_ID_WHITE>;
            led-max-microamps = <80000>;
            flash-max-microamps = <300000>;
            flash-max-timeout-us = <400000>;
        };
    };
```
