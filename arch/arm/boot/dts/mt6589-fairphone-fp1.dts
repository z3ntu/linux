// SPDX-License-Identifier: GPL-2.0+

/dts-v1/;
#include "mt6589.dtsi"

/ {
	model = "Fairphone 1";
	compatible = "fairphone,fp1", "mediatek,mt6589";

	chosen {
		bootargs = "console=ttyS3,921600n8 earlyprintk";
		stdout-path = &uart3;
	};

	memory {
		device_type = "memory";
		reg = <0x80000000 0x40000000>;
	};

};

&uart3 {
	status = "okay";
};
